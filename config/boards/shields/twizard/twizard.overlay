#include <dt-bindings/zmk/matrix_transform.h>

/ {
    chosen {
        zmk,kscan = &default_kscan;
        zmk,matrix_transform = &default_transform;
    };

    default_kscan: kscan {
        compatible = "zmk,kscan-gpio-matrix";
        label = "default_kscan";
        diode-direction = "col2row";

        row-gpios =     <&pro_micro 21 (GPIO_ACTIVE_HIGH | GPIO_PULL_DOWN)>,
                        <&pro_micro 20 (GPIO_ACTIVE_HIGH | GPIO_PULL_DOWN)>,
                        <&pro_micro 19 (GPIO_ACTIVE_HIGH | GPIO_PULL_DOWN)>,
                        <&pro_micro 18 (GPIO_ACTIVE_HIGH | GPIO_PULL_DOWN)>;

        col-gpios =     <&pro_micro 1 GPIO_ACTIVE_HIGH>,
                        <&pro_micro 0 GPIO_ACTIVE_HIGH>,
                        <&pro_micro 2 GPIO_ACTIVE_HIGH>,
                        <&pro_micro 3 GPIO_ACTIVE_HIGH>,
                        <&pro_micro 4 GPIO_ACTIVE_HIGH>,
                        <&pro_micro 5 GPIO_ACTIVE_HIGH>,
                        <&pro_micro 6 GPIO_ACTIVE_HIGH>,
                        <&pro_micro 7 GPIO_ACTIVE_HIGH>,
                        <&pro_micro 8 GPIO_ACTIVE_HIGH>,
                        <&pro_micro 9 GPIO_ACTIVE_HIGH>;
    };

    default_transform: matrix_transform {
        compatible = "zmk,matrix-transform";
        rows = <4>;
        columns = <10>;

        map = <
            RCV(0,0) RCV(0,1) RCV(0,2) RCV(0,3) RCV(0,4)    RCV(0,5) RCV(0,6) RCV(0,7) RCV(0,8) RCV(0,9)
            RCV(1,0) RCV(1,1) RCV(1,2) RCV(1,3) RCV(1,4)    RCV(1,5) RCV(1,6) RCV(1,7) RCV(1,8) RCV(1,9)
            RCV(2,0) RCV(2,1) RCV(2,2) RCV(2,3) RCV(2,4)    RCV(2,5) RCV(2,6) RCV(2,7) RCV(2,8) RCV(2,9)
            RCV(3,0) RCV(3,1) RCV(3,2) RCV(3,3) RCV(3,4)    RCV(3,5) RCV(3,6) RCV(3,7) RCV(3,8) RCV(3,9)
                     RCV(4,1) RCV(4,2) RCV(4,3) RCV(4,4)    RCV(4,5) RCV(4,6) RCV(4,7) RCV(4,8)
        >;
    };
};